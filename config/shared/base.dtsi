#include <behaviors.dtsi>
#include <dt-bindings/zmk/keys.h>
#include <dt-bindings/zmk/bt.h>
#include <dt-bindings/zmk/outputs.h>
#include <dt-bindings/zmk/pointing.h>

// Layers
// Note: Layer indices (0..4) are mapped by the Toucan2 trackpad listener.
#define BASE 0
#define NAV 1
#define NUM 2
#define MEDIA 3
#define MOUSE 4

// Behaviors Constants
#define TAPPING_TERM_MS 200
#define QUICK_TAP_MS 175
#define REQUIRE_PRIOR_IDLE_MS 150

#include "./behaviors.dtsi"
#include "./combos.dtsi"
